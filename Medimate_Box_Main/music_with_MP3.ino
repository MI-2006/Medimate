// ===========================================================================
//  music_with_MP3.ino
//  פרויקט מדימייט — מיכל יזרעאלי
//
//  שכבת הפשטת חומרה (HAL) לנגן ה-DFPlayer Mini בלבד.
//  קובץ זה אינו יודע דבר על מכונת המצבים, snooze, אזעקות, או לוגיקת מערכת.
//  תחום אחריות בלעדי: אתחול ערוץ ה-UART ושליחת פקודות גולמיות לנגן.
//
//  ממשק ציבורי (שלוש פונקציות בלבד):
//    setupMP3()        — אתחול לא-חוסם של הנגן, נקרא פעם אחת מ-setup()
//    playAlarmMelody() — שליחת פקודת ניגון לנגן
//    stopAudio()       — שליחת פקודת עצירה לנגן
// ===========================================================================

#include <DFRobotDFPlayerMini.h>

// ---------------------------------------------------------------------------
// הגדרות פינים — UART1 שמור לנגן בלבד
// פינים 16/17 שמורים ל-UART2 של חיישן טביעת האצבע ואינם בשימוש כאן
// ---------------------------------------------------------------------------
#define MP3_RX_PIN   25
#define MP3_TX_PIN   26

// ---------------------------------------------------------------------------
// קבועי נגן
// ---------------------------------------------------------------------------
static const uint8_t       ALARM_TRACK_NUMBER = 1;      // שם הקובץ בכרטיס SD: 0001.mp3
static const uint8_t       MP3_DEFAULT_VOLUME = 20;     // עוצמת ניגון, טווח אפשרי 0–30
static const unsigned long MP3_BOOT_DELAY_MS  = 2000UL; // זמן המתנה לא-חוסם לאחר הפעלת הנגן

// ---------------------------------------------------------------------------
// משתני מצב פנימיים — פרטיים לקובץ זה
// ---------------------------------------------------------------------------
static HardwareSerial      mp3Serial(1);       // ערוץ UART1, נפרד מ-UART2 של חיישן האצבע
static DFRobotDFPlayerMini dfPlayer;
static bool                mp3Initialized   = false; // האם פקודת האתחול נשלחה
static unsigned long       mp3InitTimestamp = 0;     // חותמת זמן של שליחת פקודת האתחול


// ===========================================================================
//  ממשק ציבורי
// ===========================================================================

// ---------------------------------------------------------------------------
// setupMP3()
// שולחת פקודות הגדרה ראשוניות לנגן באופן לא-חוסם לחלוטין.
//
// קריאה ל-begin עם שני פרמטרים של דיכוי המתנה:
//   הפרמטר השני (false) — אין המתנה לאישור (ACK) מהנגן.
//   הפרמטר השלישי (false) — לא נשלחת פקודת reset לנגן.
//   כתוצאה: הפונקציה מחזירה שליטה ל-loop() באופן מיידי, גם אם חוטי ה-RX/TX מנותקים.
//
// קורא פעם אחת מתוך setupHardwareActuators() שב-Hardware_Actuators.ino
// ---------------------------------------------------------------------------
void setupMP3() {
    mp3Serial.begin(9600, SERIAL_8N1, MP3_RX_PIN, MP3_TX_PIN);

    dfPlayer.begin(mp3Serial, false, false);

    dfPlayer.volume(MP3_DEFAULT_VOLUME);
    dfPlayer.EQ(DFPLAYER_EQ_NORMAL);

    mp3Initialized   = true;
    mp3InitTimestamp = millis();

    Serial.println("פקודות אתחול נגן ה-MP3 נשלחו — אין המתנה לתגובה.");
    Serial.printf("הנגן יהיה מוכן לניגון בעוד כ-%lu שניות.\n",
                  MP3_BOOT_DELAY_MS / 1000UL);
}

// ---------------------------------------------------------------------------
// playAlarmMelody()
// שולחת פקודת ניגון לנגן.
// בודקת שתי תנאים לפני שליחה:
//   1. שפקודת האתחול נשלחה (setupMP3() נקרא).
//   2. שחלף זמן אתחול מספיק מאז הפעלת הנגן (MP3_BOOT_DELAY_MS).
// שתי הבדיקות מבוססות על דגל ו-millis() בלבד — ללא כל חסימה.
// ---------------------------------------------------------------------------
void playAlarmMelody() {
    if (!mp3Initialized) {
        Serial.println("שגיאה: ניסיון ניגון לפני אתחול הנגן.");
        return;
    }

    if (millis() - mp3InitTimestamp < MP3_BOOT_DELAY_MS) {
        Serial.println("נגן ה-MP3 עדיין מאתחל — הפקודה תישלח בקריאה הבאה.");
        return;
    }

    dfPlayer.play(ALARM_TRACK_NUMBER);
    Serial.printf("נגן MP3: מנגן רצועה %d\n", ALARM_TRACK_NUMBER);
}

// ---------------------------------------------------------------------------
// stopAudio()
// שולחת פקודת עצירה לנגן.
// אינה חוסמת — שולחת בתים לערוץ הטורי ומחזירה שליטה מיד.
// ---------------------------------------------------------------------------
void stopAudio() {
    if (!mp3Initialized) {
        return;
    }

    dfPlayer.stop();
    Serial.println("נגן MP3: ניגון הופסק.");
}
