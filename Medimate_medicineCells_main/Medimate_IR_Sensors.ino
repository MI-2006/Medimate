// ===========================================================================
//  Medimate_IR_Sensors.ino   (קובץ חדש — חלק מסקיצת בקר התאים)
//  פרויקט מדימייט — מיכל יזרעאלי
//
//  תחום אחריות בלעדי (Single Responsibility):
//    • 5 חיישני IR לבקרת מלאי (אחד לכל תא) — סקירה לא-חוסמת בלולאה
//    • חיישן IR אחד של המשפך המשותף — כניסה מבוססת הפסקת-חומרה (ISR)
//
//  --- מדוע שני מנגנוני חישה שונים? ---
//
//  חיישני המלאי (5 יח'): מטרתם לדעת אם תא *ריק*. זהו מצב איטי שמשתנה
//  לכל היותר פעם אחת בחודש (כשהקשיש מחדש מלאי). דגימה חוזרת (polling)
//  עם פילטר קריאות-עוקבות מספיקה לחלוטין. חיבור ל-ISR הוא מידה מופרזת
//  (over-engineering) שמבזבזת וקטור הפסקה חומרתי ללא תועלת.
//
//  חיישן המשפך (1 יח'): מטרתו לזהות נפילת כדור — אירוע שנמשך בין מספר
//  עשרות למספר מאות מילי-שניות. אם ה-loop() עסוקה בשלב זה בשדרת ה-I2C
//  (Wire.write / Wire.onRequest) או בחישוב PWM של סרוו, הדגימה הבאה ב-
//  loop() עלולה להגיע *אחרי* שסיים הכדור לעבור. ISR מבטיח שהאירוע ייתפס
//  ב-latency של מיקרו-שניות, ללא תלות בעומס הלולאה.
//
//  --- מדוע IRAM_ATTR? ---
//  ב-ESP32, קוד מאוחסן בדרך-כלל ב-Flash (SPI). כאשר מנהל ה-WiFi, ה-OTA,
//  או כל פעולת כתיבה ל-NVS ניגשת ל-Flash, הגישה ל-Flash *חסומה* לכמה
//  מיקרו-שניות. ISR שנמצא ב-Flash בזמן הזה יגרום לקריסה (Illegal Instruction
//  exception). IRAM_ATTR מכריח את המהדר לשים את הפונקציה ב-IRAM — זיכרון
//  מהיר ותמיד נגיש, ללא תלות בסטטוס ה-Flash. זהו חוק ברזל ב-ESP32 ISR
//  — לא אופציה.
//
//  --- מדוע esp_timer_get_time() לדיבאונס ב-ISR? ---
//  millis() ב-Arduino-ESP32 מבוסס על FreeRTOS tick counter, שמתעדכן בהקשר
//  ISR אחר (SysTick). אם ה-SysTick ISR עצמו נמצא בהרצה כשה-ISR שלנו
//  נכנס, הערך שנקרא מ-millis() עלול להיות חלקי ובלתי-עקבי (race condition).
//  esp_timer_get_time() קורא ישירות את קאונטר החומרה של ESP32 (FRC1/LAC),
//  וקריאה זו היא אטומית ובטוחה לחלוטין מכל הקשר.
// ===========================================================================

#include <Arduino.h>
#include <esp_timer.h>   // נדרש עבור esp_timer_get_time()

// ---------------------------------------------------------------------------
// פיני חיישני המלאי (5 חיישני IR — סקירה בלולאה)
// הגדרה מרוכזת בקובץ זה בלבד — אין לשכפל ל-Medimate_medicineCells_main.ino
// ---------------------------------------------------------------------------
#define INV_IR_PIN_1    13
#define INV_IR_PIN_2    14
#define INV_IR_PIN_3    15
#define INV_IR_PIN_4    25
#define INV_IR_PIN_5    26

// ---------------------------------------------------------------------------
// פין חיישן המשפך (ISR — הפסקת-חומרה)
// GPIO 35 = פין קלט-בלבד ב-ESP32, תומך בהפסקות, ללא pull-up/down פנימי.
// החיישן מניח פלט פעיל (active-driven) — אין צורך בנגד pull-up חיצוני
// בצד ה-ESP32 כי מודול ה-IR כולל כבר טרנזיסטור פלט ייעודי.
// ---------------------------------------------------------------------------
#define FUNNEL_IR_PIN   35

// ---------------------------------------------------------------------------
// קבועי פילטר מלאי (קריאות-עוקבות)
//
// למה קריאות-עוקבות ולא debounce מבוסס-זמן? כי קריאה בודדת מחיישן IR
// אנלוגי-דיגיטלי עם סף (threshold) מתכוונן עלולה להיות "פעפוע" (glitch)
// כשכדור בגישה אחרונה חוצה את הסף לסירוגין. דרישת N קריאות עוקבות
// זהות מבטיחה שהשינוי יציב פיזית לפני שמשנים את הביטמאסק.
// N=5 עם מרווח 200ms = 1 שנייה סה"כ לאישור שינוי — ארוך מספיק לסנן
// גלישה, קצר מספיק לדיווח מהיר.
// ---------------------------------------------------------------------------
static const uint8_t       INV_CONSECUTIVE_READS = 5;
static const unsigned long INV_POLL_INTERVAL_MS  = 200UL;

// ---------------------------------------------------------------------------
// קבוע דיבאונס של חיישן המשפך (ב-ISR, ביחידות מיקרו-שניות)
// 50ms = 50,000µs: ארוך מספיק לדחות הד מכני של הכדור על פני החיישן,
// קצר מספיק לא לפספס כדור שני שייפול מיד לאחר הראשון (אם אי-פעם יהיה
// צורך תפעולי בכך).
// ---------------------------------------------------------------------------
static const int64_t FUNNEL_DEBOUNCE_US = 50000LL;

// ---------------------------------------------------------------------------
// משתנים גלובליים — נגישים מ-Medimate_medicineCells_main.ino (אותה סקיצה)
//
// volatile: המהדר מקמפל קבצי .ino כיחידת תרגום אחת, אך volatile נחוץ
// כאן גם-כך: הוא מונע מה-optimizer להניח שערך המשתנה לא ישתנה בין
// שתי קריאות עוקבות ב-loop() — כי הוא אכן יכול להשתנות ב-ISR בין לבין.
// ---------------------------------------------------------------------------
volatile bool    g_funnelDropDetected = false;
volatile uint8_t g_inventoryBitmask   = 0x00;

// ---------------------------------------------------------------------------
// משתנים פרטיים לקובץ זה
// ---------------------------------------------------------------------------
static const uint8_t INV_PINS[5] = {
    INV_IR_PIN_1, INV_IR_PIN_2, INV_IR_PIN_3, INV_IR_PIN_4, INV_IR_PIN_5
};

// מונים לכל חיישן: כמה קריאות "גבוה" (=ריק) ו"נמוך" (=יש מלאי) עוקבות
static uint8_t       invHighCount[5]  = {0, 0, 0, 0, 0};
static uint8_t       invLowCount[5]   = {0, 0, 0, 0, 0};
static unsigned long lastInvPollAt    = 0;

// חותמת זמן ISR — בטוחה לקריאה מ-ISR בלבד; loop() לא קוראת אותה
static volatile int64_t lastFunnelISR_us = 0;

// ===========================================================================
//  ISR — חיישן המשפך
// ===========================================================================

// ---------------------------------------------------------------------------
// onFunnelDrop() — הפסקת FALLING (מעבר HIGH→LOW = כדור מפסיק את קרן האור)
//
// כלל ISR ברזל: פחות קוד = פחות זמן ב-ISR = פחות latency לשאר המערכת.
// הפונקציה עושה שלושה דברים בלבד:
//   1. קוראת את הזמן הנוכחי מחומרה (אטומי, בטוח ב-ISR)
//   2. בודקת debounce
//   3. מציבה דגל volatile
// שום Serial, שום קריאה ל-Wire, שום חישוב מורכב.
// ---------------------------------------------------------------------------
void IRAM_ATTR onFunnelDrop() {
    int64_t now_us = esp_timer_get_time();
    if ((now_us - lastFunnelISR_us) >= FUNNEL_DEBOUNCE_US) {
        lastFunnelISR_us   = now_us;
        g_funnelDropDetected = true;
    }
}

// ===========================================================================
//  ממשק ציבורי
// ===========================================================================

// ---------------------------------------------------------------------------
// setupIRSensors() — קורא פעם אחת מ-setup() של הסקיצה הראשית\
// ---------------------------------------------------------------------------
void setupIRSensors() {
    // --- חיישני מלאי ---
    for (uint8_t i = 0; i < 5; i++) {
        pinMode(INV_PINS[i], INPUT);
    }

    // --- חיישן משפך ---
    // GPIO 35 הוא input-only — אין לקרוא לו pinMode(OUTPUT). INPUT בלבד.
    pinMode(FUNNEL_IR_PIN, INPUT);

    // FALLING: מודולי IR מסדרת "Obstacle Avoidance" מוציאים LOW כשמזוהה
    // עצם (כדור חוסם את הקרן), HIGH כשהנתיב פנוי. מעבר HIGH→LOW = כניסת כדור.
    attachInterrupt(digitalPinToInterrupt(FUNNEL_IR_PIN), onFunnelDrop, FALLING);

    Serial.println("חיישני IR אותחלו: 5 מלאי (סקירה) + 1 משפך (ISR/FALLING).");
}

// ---------------------------------------------------------------------------
// pollInventoryIR() — קורא בכל איטרציה של loop()
// מגביל קצב פנימית (INV_POLL_INTERVAL_MS); חוזר מיד אם טרם הגיע הזמן.
// מעדכן את g_inventoryBitmask באמצעות פעולות ביטים בלבד — אין מערכים,
// אין JSON, אין מחרוזות.
//
// פירוש ערכי החיישן:
//   HIGH = אין חסימה = כדורים נגמרו = מלאי נמוך  → מציב ביט
//   LOW  = יש חסימה  = כדורים קיימים            → מוחק ביט
//
// חשוב: המהדר רשאי לבצע reorder על פעולות שאינן volatile. שימוש ב-
// __atomic_fetch_or / __atomic_fetch_and הוא האפשרות העמידה לחלוטין.
// כאן ב-ESP32 עם ליבה אחת רצה את הקוד הזה (loop task) ו-ISR ב-ליבה
// אחרת, volatile uint8_t הוא מספיק לגישה על בית בודד (atomic ברמת 
// החומרה); בכל-זאת, אם תעברי ל-FreeRTOS עם מספר tasks שכותבים לאותו
// ביטמאסק — עברי ל-critical section.
// ---------------------------------------------------------------------------
void pollInventoryIR() {
    unsigned long now = millis();
    if (now - lastInvPollAt < INV_POLL_INTERVAL_MS) {
        return;
    }
    lastInvPollAt = now;

    for (uint8_t i = 0; i < 5; i++) {
        if (digitalRead(INV_PINS[i]) == HIGH) {
            // HIGH = כדורים נגמרו = מלאי נמוך
            if (invHighCount[i] < INV_CONSECUTIVE_READS) {
                invHighCount[i]++;
            }
            invLowCount[i] = 0;

            if (invHighCount[i] >= INV_CONSECUTIVE_READS) {
                g_inventoryBitmask |= (uint8_t)(1u << i);   // מציב ביט = מלאי נמוך
            }
        } else {
            // LOW = יש כדורים = מלאי תקין
            if (invLowCount[i] < INV_CONSECUTIVE_READS) {
                invLowCount[i]++;
            }
            invHighCount[i] = 0;

            if (invLowCount[i] >= INV_CONSECUTIVE_READS) {
                g_inventoryBitmask &= (uint8_t)(~(1u << i)); // מוחק ביט = מלאי קיים
            }
        }
    }
}

// ---------------------------------------------------------------------------
// clearFunnelFlag() — מאפס את דגל ה-ISR לפני כל מחזור שחרור חדש.
// חובה לקרוא לפני פתיחת הסרוו, לא אחרי — כדי לא לפספס נפילה שקרתה
// בזמן תנועת הסרוו.
// ---------------------------------------------------------------------------
void clearFunnelFlag() {
    g_funnelDropDetected = false;
}
